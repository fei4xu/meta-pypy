## conf/layer.conf
```bitbake
# We have a conf and classes directory, add to BBPATH
BBPATH .= ":${LAYERDIR}"

# We have recipes-* directories, add to BBFILES
BBFILES += "${LAYERDIR}/recipes-*/*/*.bb ${LAYERDIR}/recipes-*/*/*.bbappend"

BBFILE_COLLECTIONS += "pypy"
BBFILE_PATTERN_pypy = "^${LAYERDIR}/"
BBFILE_PRIORITY_pypy = "1"

# This should only be incremented on significant changes that will
# cause compatibility issues with other layers
LAYERVERSION_pypy = "1"

LAYERDEPENDS_pypy = "core"
```
